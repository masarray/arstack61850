## embedded/esp32p4_smv_injector/main/Kconfig.projbuild
```kconfig
menu "ARStack ESP32-P4 SMV Injector"

config AR_SMV_LIVE_TX
    bool "Enable raw Layer-2 Sampled Values transmission"
    default n
    help
        Enables active IEC 61850 Sampled Values Ethernet transmission after
        the PHY reports link-up. Use only on an isolated laboratory process-bus
        network or a direct capture-NIC connection.

config AR_SMV_P2_REALTIME_50HZ
    bool "Enable P2 50 Hz / 80 samples-per-cycle realtime publisher"
    default y
    depends on AR_SMV_LIVE_TX
    help
        Publishes 4000 Sampled Values frames per second with a 250 us hardware
        timer schedule, 4000-count canonical smpCnt wrap, prebuilt frame
        templates and a generated balanced three-phase waveform.

config AR_SMV_CANONICAL_VLAN
    bool "Tag canonical multicast SV with VLAN PCP 4 / VID 0"
    default y
    depends on AR_SMV_P2_REALTIME_50HZ
    help
        Keeps the standards-facing multicast stream priority tagged. Disable
        only for targeted capture-path diagnosis.

config AR_SMV_BROADCAST_MIRROR
    bool "Enable isolated untagged broadcast capture mirror"
    default y
    depends on AR_SMV_P2_REALTIME_50HZ
    help
        Sends a lab-only untagged broadcast diagnostic stream for capture
        adapters/drivers that discard IEC 61850 multicast or priority-tagged
        frames. The mirror uses its own APPID/svID and a normal 16-bit smpCnt
        sequence so analysis software cannot merge it with the canonical SCL
        stream. It also carries smpRate/smpMod explicitly for raw waveform
        reconstruction. Do not treat this mirror as the standards-facing
        process-bus stream.

config AR_SMV_DIAGNOSTIC_PROBES
    bool "Enable 0x88B5 broadcast/multicast probes once per second"
    default n
    depends on AR_SMV_P2_REALTIME_50HZ
    help
        Adds low-rate non-SV probes for capture-path troubleshooting. Keep this
        disabled while measuring realtime timing unless it is needed.

config AR_PTP_LAB_TX
    bool "Enable PTPv2 Layer-2 timing task"
    default n
    help
        Enables the isolated PTP timing subsystem. Role 0 is a lab source,
        role 1 is a measured external-time receiver with clock discipline, and
        role 2 is passive monitor-only. This feature is not a GPS-backed or
        certified grandmaster claim.

config AR_SMV_PTP_PHASE_SERVO_EXPERIMENTAL
    bool "LAB ONLY: continuous bounded PTP-to-SV phase steering (experimental)"
    default n
    depends on AR_PTP_LAB_TX && AR_SMV_P2_REALTIME_50HZ
    help
        Opt-in experimental EMAC-PTP / GPTimer phase bridge. Reads hardware
        clocks in a low-priority task once per SV second, then distributes
        at most 400 +/-1us corrections across remaining SV deadlines.
        Requires SOURCE active BEFORE SV START and exactly one transmitted
        ASDU per sample with publisher fps matching smpCnt modulus.
        AUTO smpSynch remains unsynchronized until independent wire/hardware
        timestamp evidence is available. DO NOT use on a live substation.

config AR_SMV_HW_TX_EVIDENCE_EXPERIMENTAL
    bool "LAB ONLY: sparse canonical SV EMAC hardware TX timestamp evidence"
    default n
    depends on AR_SMV_PTP_PHASE_SERVO_EXPERIMENTAL && !AR_SMV_BROADCAST_MIRROR && !AR_SMV_DIAGNOSTIC_PROBES
    help
        Diagnostic only: once per 2 canonical smpCnt-zero epochs, use the
        ESP32-P4 MAC extended TX API to request a descriptor timestamp on
        the actual SV frame, while all other frames use the regular TX path.
        The ESP-IDF 5.x driver busy-waits for the selected descriptor, which
        can perturb realtime scheduling; never enable on a live process bus.
        Disable the broadcast mirror and diagnostic probes to avoid extra
        competing TX traffic. Missing/non-SV timestamps are recorded as
        unavailable, never substituted with esp_timer time or claimed as
        proof that a relay has synchronized. Defaults OFF.

config AR_PTP_BOOT_SOURCE_AUTOSTART
    bool "LAB ONLY: start local PTP SOURCE and SV dry sample grid on boot"
    default n
    depends on AR_PTP_LAB_TX && AR_SMV_PTP_PHASE_SERVO_EXPERIMENTAL
    help
        Explicit isolated-laboratory feature: after PHY link is verified,
        start the configured PTP LAB SOURCE automatically once at boot.
        Existing inactive-SV preflight then aligns its dry GPTimer without
        requiring Studio START or a USB serial session. The boot supervisor
        never starts SOURCE when role is RECEIVER/MONITOR, never restarts
        after operator PTP START/STOP/CONFIG, and limits failed retries.
        SV Ethernet transmission remains OFF until operator SV START.
        Never enable while connected to an energized utility process bus.

config AR_PTP_AUTO_PREFER_EXTERNAL
    bool "LAB ONLY: prefer better qualified external GM using safe EMAC handover"
    default n
    depends on AR_PTP_BOOT_SOURCE_AUTOSTART && AR_PTP_RESPOND_PDELAY
    help
        In an isolated process-bus simulator, observe foreign PTP Announce
        through the existing local SOURCE peer-delay RX callback. Prefer
        an independently stable, strictly better foreign GM only while
        the operator's SV injection is STOPPED. Drain local SOURCE fully,
        then run the measured Pdelay/Sync TIME_RECEIVER and require actual
        discipline LOCK before qualifying SV. Never run both roles on one
        ESP32-P4 EMAC simultaneously, and do not switch during live SV TX.
        Advanced runtime mode selection is a later M3.D task.

config AR_PTP_AUTO_LOCAL_FALLBACK
    bool "LAB ONLY: restore internal SOURCE after external GM is fully absent"
    default n
    depends on AR_PTP_AUTO_PREFER_EXTERNAL
    help
        Explicit isolated-bench authorization to restore local GM if the
        external receiver has no selected Announce for at least 15 seconds,
        the operator's SV output is STOPPED and cleanup completes. Never
        promote a local GM in an energized utility network or while a
        foreign GM is selected; a partially failed receiver is not proof
        that the foreign network is absent.

config AR_PTP_OPERATING_ROLE
    int "PTP operating role (0=lab source, 1=time receiver, 2=monitor)"
    range 0 2
    default 0
    depends on AR_PTP_LAB_TX
    help
        LAB_SOURCE sends Announce/Sync and can answer Pdelay. TIME_RECEIVER
        listens to an external PTP source, performs hardware-timestamped peer
        delay, and disciplines the ESP32-P4 IEEE1588 clock. MONITOR is passive.

config AR_PTP_ALLOW_NONSTANDARD_LAB_CADENCE
    bool "LAB ONLY: allow non-IEC 61850-9-3 SOURCE cadence"
    default n
    depends on AR_PTP_LAB_TX
    help
        Default SOURCE admission enforces nominal 1-second Announce and Sync
        and an enabled hardware peer-delay responder, as expected by the
        IEC/IEEE 61850-9-3 power utility profile. Turn this on ONLY for
        intentional isolated nonstandard packet tests; it does not make
        the LAB_SOURCE a traceable certified PTP Grandmaster.

config AR_PTP_DOMAIN
    int "PTP domain number"
    range 0 255
    default 0
    depends on AR_PTP_LAB_TX

config AR_PTP_TRANSPORT_SPECIFIC
    int "PTP transportSpecific nibble"
    range 0 15
    default 0
    depends on AR_PTP_LAB_TX
    help
        Upper-nibble transportSpecific value written into PTP messageType.
        Strict receivers may reject a profile mismatch.

config AR_PTP_CLOCK_IDENTITY
    string "PTP clockIdentity override (empty = derive from MAC)"
    default ""
    depends on AR_PTP_LAB_TX
    help
        Optional 8-byte identity such as 02:11:22:FF:FE:33:44:55. Leave empty
        to derive an EUI-64-style identity from the ESP32-P4 Ethernet MAC.

config AR_PTP_PORT_NUMBER
    int "PTP port number"
    range 1 65535
    default 1
    depends on AR_PTP_LAB_TX

config AR_PTP_VLAN
    bool "Tag PTP traffic with IEEE 802.1Q VLAN (Power Profile PCP4/VID0)"
    default y
    depends on AR_PTP_LAB_TX

config AR_PTP_VLAN_ID
    int "PTP VLAN ID (0 means 802.1Q priority tag)"
    range 0 4094
    default 0
    depends on AR_PTP_LAB_TX && AR_PTP_VLAN

config AR_PTP_VLAN_PRIORITY
    int "PTP VLAN PCP"
    range 0 7
    default 4
    depends on AR_PTP_LAB_TX && AR_PTP_VLAN

config AR_PTP_ANNOUNCE_INTERVAL_MS
    int "PTP Announce interval (ms)"
    range 100 10000
    default 1000
    depends on AR_PTP_LAB_TX

config AR_PTP_SYNC_INTERVAL_MS
    int "PTP Sync interval (ms)"
    range 20 5000
    default 1000
    depends on AR_PTP_LAB_TX
    help
        LAB_SOURCE uses two-step Sync/Follow_Up so Follow_Up can carry the exact
        EMAC transmit timestamp rather than a software send-time estimate.

config AR_PTP_RESPOND_PDELAY
    bool "Respond to peer-delay requests in LAB_SOURCE"
    default y
    depends on AR_PTP_LAB_TX
    help
        Uses the ESP32-P4 RX descriptor timestamp as t2 and the Pdelay_Resp TX
        descriptor timestamp as t3 for Pdelay_Resp_Follow_Up.

config AR_PTP_PDELAY_REQUEST_INTERVAL_MS
    int "TIME_RECEIVER peer-delay request interval (ms)"
    range 100 10000
    default 1000
    depends on AR_PTP_LAB_TX

config AR_PTP_PRIORITY1
    int "PTP priority1"
    range 0 255
    default 128
    depends on AR_PTP_LAB_TX

config AR_PTP_PRIORITY2
    int "PTP priority2"
    range 0 255
    default 128
    depends on AR_PTP_LAB_TX

config AR_PTP_CLOCK_CLASS
    int "PTP clockClass"
    range 0 255
    default 248
    depends on AR_PTP_LAB_TX
    help
        Default 248 deliberately describes a conservative lab clock rather than
        falsely claiming a GPS-disciplined or traceable grandmaster.

config AR_PTP_CLOCK_ACCURACY
    int "PTP clockAccuracy octet"
    range 0 255
    default 254
    depends on AR_PTP_LAB_TX
    help
        254 (0xFE) is Unknown and is the conservative default.

config AR_PTP_OFFSET_SCALED_LOG_VARIANCE
    int "PTP offsetScaledLogVariance"
    range 0 65535
    default 65535
    depends on AR_PTP_LAB_TX

config AR_PTP_TIME_SOURCE
    int "PTP timeSource octet"
    range 0 255
    default 160
    depends on AR_PTP_LAB_TX
    help
        160 (0xA0) is Internal Oscillator. Do not select GPS unless an external
        disciplined source actually provides that evidence.

config AR_PTP_CURRENT_UTC_OFFSET
    int "PTP currentUtcOffset"
    range -32768 32767
    default 37
    depends on AR_PTP_LAB_TX

config AR_PTP_MANUAL_UTC_OFFSET_VALID
    bool "UTC offset manually verified (Announce currentUtcOffsetValid)"
    default n
    depends on AR_PTP_LAB_TX
    help
        Enable only after the operator verifies the configured TAI-UTC offset
        against an authoritative leap-second record AND verifies that the
        RTC-derived UTC epoch is meaningfully correct. Without this, SOURCE
        advertises neither the PTP-timescale nor offset-valid flag even if
        the hardware clock could be seeded. This remains an INTERNAL
        OSCILLATOR and does NOT imply UTC traceability, frequency lock,
        microsecond-grade accuracy, or a certified Grandmaster.
        The runtime also requires a plausible system UTC epoch before it
        advertises currentUtcOffsetValid.

config AR_PTP_MAX_PATH_DELAY_NS
    int "TIME_RECEIVER maximum accepted peer path delay (ns)"
    range 1000 100000000
    default 5000000
    depends on AR_PTP_LAB_TX

config AR_PTP_MAX_PATH_JITTER_NS
    int "TIME_RECEIVER maximum accepted path-delay jitter (ns)"
    range 0 10000000
    default 100000
    depends on AR_PTP_LAB_TX

config AR_PTP_LOCK_OFFSET_NS
    int "TIME_RECEIVER LOCKED offset threshold (ns)"
    range 100 1000000
    default 2000
    depends on AR_PTP_LAB_TX

config AR_PTP_UNLOCK_OFFSET_NS
    int "TIME_RECEIVER unlock offset threshold (ns)"
    range 100 10000000
    default 20000
    depends on AR_PTP_LAB_TX

config AR_PTP_PHASE_STEP_THRESHOLD_NS
    int "TIME_RECEIVER phase-step threshold while acquiring (ns)"
    range 1000 1000000000
    default 1000000
    depends on AR_PTP_LAB_TX

config AR_PTP_LOCK_REQUIRED_SAMPLES
    int "TIME_RECEIVER consecutive qualified samples required for LOCKED"
    range 2 100
    default 8
    depends on AR_PTP_LAB_TX

config AR_PTP_SYNC_TIMEOUT_MS
    int "TIME_RECEIVER Sync timeout before HOLDOVER/UNLOCKED (ms)"
    range 100 10000
    default 3000
    depends on AR_PTP_LAB_TX

config AR_PTP_HOLDOVER_TIMEOUT_MS
    int "TIME_RECEIVER bounded HOLDOVER duration (ms)"
    range 100 60000
    default 5000
    depends on AR_PTP_LAB_TX

config AR_PTP_MAX_FREQ_ADJ_PPB
    int "TIME_RECEIVER maximum absolute frequency correction (ppb)"
    range 1000 1000000
    default 100000
    depends on AR_PTP_LAB_TX

config AR_SMV_CURRENT_RMS_MA
    int "Balanced phase current RMS (mA)"
    range 0 100000
    default 1000
    depends on AR_SMV_P2_REALTIME_50HZ
    help
        RMS current used by the built-in waveform generator. The 9-2LE-shaped
        payload uses 1 mA per integer count.

config AR_SMV_VOLTAGE_RMS_MV
    int "Balanced phase-to-neutral voltage RMS (mV)"
    range 0 100000000
    default 57740
    depends on AR_SMV_P2_REALTIME_50HZ
    help
        RMS voltage used by the built-in waveform generator. The 9-2LE-shaped
        payload uses 10 mV per integer count. The default is approximately
        57.74 V phase-to-neutral (100 V line-to-line).

endmenu
```

## ports/esp_idf/brcb_flash_probe_app/sdkconfig.defaults
```kconfig
CONFIG_COMPILER_CXX_EXCEPTIONS=n
CONFIG_PARTITION_TABLE_CUSTOM=y
CONFIG_PARTITION_TABLE_CUSTOM_FILENAME="partitions.csv"
CONFIG_ESP_CONSOLE_UART_DEFAULT=y
CONFIG_ESP_CONSOLE_UART_BAUDRATE=115200
```
